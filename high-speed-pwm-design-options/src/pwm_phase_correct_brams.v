// Phase-Correct (Up-Down) PWM Counter + 3-Channel Dead-Time Gate Generator
// 11-bit counter / duty values (range 0..2047, period 4096 fast cycles).
//
// Counter source: BRAM-based lookup. A free-running 12-bit address
// counter feeds a 4096 × 13-bit ROM whose contents encode:
//   data[10:0] = counter value at that point in the period (0->2047->0
//                triangle with 1-cycle dwell at peak and trough)
//   data[11]   = sync (high at addr 0)
//   data[12]   = direction (0 = up, 1 = down)
// No add/sub or boundary logic in fabric — it's all in the table.
// ROM contents are generated by scripts/gen_counter_rom.py into
// build/counter_table.hex and inferred to SB_RAM40_4K by yosys.
//
// Per-phase dead-time logic, asymmetric on counter direction:
//   Up-counting   : gate_high = (counter <  duty),
//                   gate_low  = (counter >= duty + dead_time)
//   Down-counting : gate_high = (counter <  duty - dead_time),
//                   gate_low  = (counter >= duty)
// Each 11-bit compare is carry-split 6 lsb + 5 msb across two pipeline
// stages so neither stage carries the full 11-bit chain. Stage 3 is the
// gate-FF mux. Total latency BRAM-out -> gate: 3 register stages.
//
// "Always running" — no OPEN/BRAKE handling. Gate outputs are always
// driven by the registered compare results. Upstream should hold duties
// at zero (or use external gating) when the bridge should be off.

module pwm_phase_correct_brams(
    input  wire        clk,
    input  wire        rst_n,
    input  wire [3:0]  bus_ctrl,
    input  wire [10:0] bus,
    output reg         sync,
    output reg         gate_uh,
    output reg         gate_ul,
    output reg         gate_vh,
    output reg         gate_vl,
    output reg         gate_wh,
    output reg         gate_wl
);

    // ============================================================
    // Bus-decoded duty registers (slow-domain writes)
    // ============================================================    

    reg [10:0] duty_u;
    reg [10:0] duty_v;
    reg [10:0] duty_w;
    reg [10:0] duty_u_minus_dt;
    reg [10:0] duty_u_plus_dt;
    reg [10:0] duty_v_minus_dt;
    reg [10:0] duty_v_plus_dt;
    reg [10:0] duty_w_minus_dt;
    reg [10:0] duty_w_plus_dt;
								 
    always @(posedge clk or negedge rst_n) begin
        if (!rst_n) begin
          duty_u <= 11'd0;
          duty_v <= 11'd0;
          duty_w <= 11'd0;
          duty_u_minus_dt <= 11'd0;
          duty_u_plus_dt <= 11'd0;
          duty_v_minus_dt <= 11'd0;
          duty_v_plus_dt <= 11'd0;
          duty_w_minus_dt <= 11'd0;
          duty_w_plus_dt <= 11'd0;
        end
        else
           if (bus_ctrl == 4'd0)
             duty_u <= bus;
           else if (bus_ctrl == 4'd1)
             duty_v <= bus;
           else if (bus_ctrl == 4'd2)
             duty_w <= bus;
           else if (bus_ctrl == 4'd3)
             duty_u_minus_dt <= bus;
           else if (bus_ctrl == 4'd4)
             duty_u_plus_dt <= bus;
           else if (bus_ctrl == 4'd5)
             duty_v_minus_dt <= bus;
           else if (bus_ctrl == 4'd6)
             duty_v_plus_dt <= bus;
           else if (bus_ctrl == 4'd7)
             duty_w_minus_dt <= bus;
           else if (bus_ctrl == 4'd8)
             duty_w_plus_dt <= bus;
    end

    // ============================================================
    // BRAM-based counter / direction / sync source
    // ============================================================
    reg [11:0] addr;

    always @(posedge clk or negedge rst_n) begin
        if (!rst_n)         addr <= 12'd0;
        else  addr <= addr + 12'd1;
    end

    reg [12:0] table_data [0:4095];
    initial $readmemh("build/counter_table.hex", table_data);

    reg [12:0] rom_out;     // BRAM read latch (yosys absorbs into BRAM
                            // internal output register).

    always @(posedge clk) begin
        rom_out <= table_data[addr];
    end

    // *Important* Fabric pipeline register between the BRAM column and
    // the consumers. Breaks the long BRAM->fabric routing hop (was
    //  ~4.7 ns from the critical-path report) into two shorter ones — 
    // nextpnr is free to place this flop in the fabric between the BRAM
    // and the gate-FF region. (* keep *) prevents any optimisation that
    // would collapse it back into the BRAM's internal register.
    (* keep *) reg [12:0] rom_out_pipe;

    always @(posedge clk) begin
        rom_out_pipe <= rom_out;
    end

    wire [10:0] counter   = rom_out_pipe[10:0];
    wire        rom_sync  = rom_out_pipe[11];
    wire        direction = rom_out_pipe[12];

    // sync output: one extra register so it's a clean pad-driver.
    always @(posedge clk or negedge rst_n) begin
        if (!rst_n) sync <= 1'b0;
        else        sync <= rom_sync;
    end

    // ============================================================
    // Direction pipelined to align with the 3-stage compare pipe.
    // s1_direction is alongside the sub-compare flops; s2_direction
    // is alongside the combine flops; the gate-FF mux reads s2.
    // ============================================================
    reg s1_direction;
    reg s2_direction;

    always @(posedge clk or negedge rst_n) begin
        if (!rst_n) begin
            s1_direction <= 1'b0;
            s2_direction <= 1'b0;
        end else begin
            s1_direction <= direction;
            s2_direction <= s1_direction;
        end
    end

    // ============================================================
    // Counter / duty splits (combinational): 6 lsb + 5 msb.
    // Used by the per-phase carry-split compares below.
    // ============================================================
    wire [4:0] counter_hi          = counter[10:6];
    wire [5:0] counter_lo          = counter[5:0];

    wire [4:0] duty_u_hi           = duty_u[10:6];
    wire [5:0] duty_u_lo           = duty_u[5:0];
    wire [4:0] duty_u_minus_dt_hi  = duty_u_minus_dt[10:6];
    wire [5:0] duty_u_minus_dt_lo  = duty_u_minus_dt[5:0];
    wire [4:0] duty_u_plus_dt_hi   = duty_u_plus_dt[10:6];
    wire [5:0] duty_u_plus_dt_lo   = duty_u_plus_dt[5:0];

    wire [4:0] duty_v_hi           = duty_v[10:6];
    wire [5:0] duty_v_lo           = duty_v[5:0];
    wire [4:0] duty_v_minus_dt_hi  = duty_v_minus_dt[10:6];
    wire [5:0] duty_v_minus_dt_lo  = duty_v_minus_dt[5:0];
    wire [4:0] duty_v_plus_dt_hi   = duty_v_plus_dt[10:6];
    wire [5:0] duty_v_plus_dt_lo   = duty_v_plus_dt[5:0];

    wire [4:0] duty_w_hi           = duty_w[10:6];
    wire [5:0] duty_w_lo           = duty_w[5:0];
    wire [4:0] duty_w_minus_dt_hi  = duty_w_minus_dt[10:6];
    wire [5:0] duty_w_minus_dt_lo  = duty_w_minus_dt[5:0];
    wire [4:0] duty_w_plus_dt_hi   = duty_w_plus_dt[10:6];
    wire [5:0] duty_w_plus_dt_lo   = duty_w_plus_dt[5:0];

    // ============================================================
    // Phase U pipelined dead-time
    //   stage 1: 5-bit hi-lt / 5-bit hi-eq / 6-bit lo-lt sub-compares
    //   stage 2: combine via hi_lt | (hi_eq & lo_lt)
    //   stage 3: gate-FF mux on s2_direction; ge derived as ~lt
    // ============================================================
    reg s1u_hi_lt_du,    s1u_hi_eq_du,    s1u_lo_lt_du;
    reg s1u_hi_lt_dumdt, s1u_hi_eq_dumdt, s1u_lo_lt_dumdt;
    reg s1u_hi_lt_dupdt, s1u_hi_eq_dupdt, s1u_lo_lt_dupdt;

    always @(posedge clk or negedge rst_n) begin
        if (!rst_n) begin
            s1u_hi_lt_du    <= 1'b0; s1u_hi_eq_du    <= 1'b0; s1u_lo_lt_du    <= 1'b0;
            s1u_hi_lt_dumdt <= 1'b0; s1u_hi_eq_dumdt <= 1'b0; s1u_lo_lt_dumdt <= 1'b0;
            s1u_hi_lt_dupdt <= 1'b0; s1u_hi_eq_dupdt <= 1'b0; s1u_lo_lt_dupdt <= 1'b0;
        end else begin
            s1u_hi_lt_du    <= (counter_hi <  duty_u_hi);
            s1u_hi_eq_du    <= (counter_hi == duty_u_hi);
            s1u_lo_lt_du    <= (counter_lo <  duty_u_lo);
            s1u_hi_lt_dumdt <= (counter_hi <  duty_u_minus_dt_hi);
            s1u_hi_eq_dumdt <= (counter_hi == duty_u_minus_dt_hi);
            s1u_lo_lt_dumdt <= (counter_lo <  duty_u_minus_dt_lo);
            s1u_hi_lt_dupdt <= (counter_hi <  duty_u_plus_dt_hi);
            s1u_hi_eq_dupdt <= (counter_hi == duty_u_plus_dt_hi);
            s1u_lo_lt_dupdt <= (counter_lo <  duty_u_plus_dt_lo);
        end
    end

    reg s2u_lt_du, s2u_lt_dumdt, s2u_lt_dupdt;

    always @(posedge clk or negedge rst_n) begin
        if (!rst_n) begin
            s2u_lt_du    <= 1'b0;
            s2u_lt_dumdt <= 1'b0;
            s2u_lt_dupdt <= 1'b0;
        end else begin
            s2u_lt_du    <= s1u_hi_lt_du    | (s1u_hi_eq_du    & s1u_lo_lt_du);
            s2u_lt_dumdt <= s1u_hi_lt_dumdt | (s1u_hi_eq_dumdt & s1u_lo_lt_dumdt);
            s2u_lt_dupdt <= s1u_hi_lt_dupdt | (s1u_hi_eq_dupdt & s1u_lo_lt_dupdt);
        end
    end

    always @(posedge clk or negedge rst_n) begin
        if (!rst_n) begin
            gate_uh <= 1'b0;
            gate_ul <= 1'b0;
        end else begin
            gate_uh <= (s2_direction == 1'b0) ?  s2u_lt_du
                                              :  s2u_lt_dumdt;
            gate_ul <= (s2_direction == 1'b0) ? ~s2u_lt_dupdt
                                              : ~s2u_lt_du;
        end
    end

    // ============================================================
    // Phase V pipelined dead-time
    // ============================================================
    reg s1v_hi_lt_du,    s1v_hi_eq_du,    s1v_lo_lt_du;
    reg s1v_hi_lt_dumdt, s1v_hi_eq_dumdt, s1v_lo_lt_dumdt;
    reg s1v_hi_lt_dupdt, s1v_hi_eq_dupdt, s1v_lo_lt_dupdt;

    always @(posedge clk or negedge rst_n) begin
        if (!rst_n) begin
            s1v_hi_lt_du    <= 1'b0; s1v_hi_eq_du    <= 1'b0; s1v_lo_lt_du    <= 1'b0;
            s1v_hi_lt_dumdt <= 1'b0; s1v_hi_eq_dumdt <= 1'b0; s1v_lo_lt_dumdt <= 1'b0;
            s1v_hi_lt_dupdt <= 1'b0; s1v_hi_eq_dupdt <= 1'b0; s1v_lo_lt_dupdt <= 1'b0;
        end else begin
            s1v_hi_lt_du    <= (counter_hi <  duty_v_hi);
            s1v_hi_eq_du    <= (counter_hi == duty_v_hi);
            s1v_lo_lt_du    <= (counter_lo <  duty_v_lo);
            s1v_hi_lt_dumdt <= (counter_hi <  duty_v_minus_dt_hi);
            s1v_hi_eq_dumdt <= (counter_hi == duty_v_minus_dt_hi);
            s1v_lo_lt_dumdt <= (counter_lo <  duty_v_minus_dt_lo);
            s1v_hi_lt_dupdt <= (counter_hi <  duty_v_plus_dt_hi);
            s1v_hi_eq_dupdt <= (counter_hi == duty_v_plus_dt_hi);
            s1v_lo_lt_dupdt <= (counter_lo <  duty_v_plus_dt_lo);
        end
    end

    reg s2v_lt_du, s2v_lt_dumdt, s2v_lt_dupdt;

    always @(posedge clk or negedge rst_n) begin
        if (!rst_n) begin
            s2v_lt_du    <= 1'b0;
            s2v_lt_dumdt <= 1'b0;
            s2v_lt_dupdt <= 1'b0;
        end else begin
            s2v_lt_du    <= s1v_hi_lt_du    | (s1v_hi_eq_du    & s1v_lo_lt_du);
            s2v_lt_dumdt <= s1v_hi_lt_dumdt | (s1v_hi_eq_dumdt & s1v_lo_lt_dumdt);
            s2v_lt_dupdt <= s1v_hi_lt_dupdt | (s1v_hi_eq_dupdt & s1v_lo_lt_dupdt);
        end
    end

    always @(posedge clk or negedge rst_n) begin
        if (!rst_n) begin
            gate_vh <= 1'b0;
            gate_vl <= 1'b0;
        end else begin
            gate_vh <= (s2_direction == 1'b0) ?  s2v_lt_du
                                              :  s2v_lt_dumdt;
            gate_vl <= (s2_direction == 1'b0) ? ~s2v_lt_dupdt
                                              : ~s2v_lt_du;
        end
    end

    // ============================================================
    // Phase W pipelined dead-time
    // ============================================================
    reg s1w_hi_lt_du,    s1w_hi_eq_du,    s1w_lo_lt_du;
    reg s1w_hi_lt_dumdt, s1w_hi_eq_dumdt, s1w_lo_lt_dumdt;
    reg s1w_hi_lt_dupdt, s1w_hi_eq_dupdt, s1w_lo_lt_dupdt;

    always @(posedge clk or negedge rst_n) begin
        if (!rst_n) begin
            s1w_hi_lt_du    <= 1'b0; s1w_hi_eq_du    <= 1'b0; s1w_lo_lt_du    <= 1'b0;
            s1w_hi_lt_dumdt <= 1'b0; s1w_hi_eq_dumdt <= 1'b0; s1w_lo_lt_dumdt <= 1'b0;
            s1w_hi_lt_dupdt <= 1'b0; s1w_hi_eq_dupdt <= 1'b0; s1w_lo_lt_dupdt <= 1'b0;
        end else begin
            s1w_hi_lt_du    <= (counter_hi <  duty_w_hi);
            s1w_hi_eq_du    <= (counter_hi == duty_w_hi);
            s1w_lo_lt_du    <= (counter_lo <  duty_w_lo);
            s1w_hi_lt_dumdt <= (counter_hi <  duty_w_minus_dt_hi);
            s1w_hi_eq_dumdt <= (counter_hi == duty_w_minus_dt_hi);
            s1w_lo_lt_dumdt <= (counter_lo <  duty_w_minus_dt_lo);
            s1w_hi_lt_dupdt <= (counter_hi <  duty_w_plus_dt_hi);
            s1w_hi_eq_dupdt <= (counter_hi == duty_w_plus_dt_hi);
            s1w_lo_lt_dupdt <= (counter_lo <  duty_w_plus_dt_lo);
        end
    end

    reg s2w_lt_du, s2w_lt_dumdt, s2w_lt_dupdt;

    always @(posedge clk or negedge rst_n) begin
        if (!rst_n) begin
            s2w_lt_du    <= 1'b0;
            s2w_lt_dumdt <= 1'b0;
            s2w_lt_dupdt <= 1'b0;
        end else begin
            s2w_lt_du    <= s1w_hi_lt_du    | (s1w_hi_eq_du    & s1w_lo_lt_du);
            s2w_lt_dumdt <= s1w_hi_lt_dumdt | (s1w_hi_eq_dumdt & s1w_lo_lt_dumdt);
            s2w_lt_dupdt <= s1w_hi_lt_dupdt | (s1w_hi_eq_dupdt & s1w_lo_lt_dupdt);
        end
    end

    always @(posedge clk or negedge rst_n) begin
        if (!rst_n) begin
            gate_wh <= 1'b0;
            gate_wl <= 1'b0;
        end else begin
            gate_wh <= (s2_direction == 1'b0) ?  s2w_lt_du
                                              :  s2w_lt_dumdt;
            gate_wl <= (s2_direction == 1'b0) ? ~s2w_lt_dupdt
                                              : ~s2w_lt_du;
        end
    end

endmodule
